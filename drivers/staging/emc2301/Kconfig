## drivers/staging/emc2301/Kconfig
```kconfig
config SENSORS_EMC2301
	tristate "SMSC EMC2301"
	depends on I2C
	help
	  If you say yes here you get support for the temperature
	  and fan sensors of the SMSC EMC2301 chips.

	  This driver can also be built as a module. If so, the module
	  will be called emc2301.
```

## drivers/staging/hailo/linux/pcie/Kconfig
```kconfig
config STAGING_HAILO_DRIVER
	tristate "Hailo AI PCIE driver"
	depends on I2C
	help
	  Hailo AI PCIE driver
```

## drivers/staging/max1726x/Kconfig
```kconfig
config BATTERY_MAX1726X
	tristate "MAX1726X gas-gauge"
	depends on I2C
	help
	  MAX1726x is fuel-gauge system for lithium-ion (Li+) batteries
	  in handheld and portable equipment.
```
